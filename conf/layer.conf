## conf/layer.conf
```bitbake
# We have a conf and classes directory, append to BBPATH
BBPATH .= ":${LAYERDIR}"

# We have a recipes directory, add to BBFILES
BBFILES += "${LAYERDIR}/recipes*/*/*.bb ${LAYERDIR}/recipes*/*/*.bbappend"

BBFILE_COLLECTIONS += "meta-mvs"
BBFILE_PATTERN_meta-mvs := "^${LAYERDIR}/"
BBFILE_PRIORITY_meta-mvs = "10"
```

## conf/machine/exokey.conf
```bitbake
#@TYPE: Machine
#@Name: ATMEL SAMA5D3xek
#@DESCRIPTION: Machine configuration for Atmel's evaluation board

require conf/machine/include/tune-cortexa9.inc

MACHINE_FEATURES = "kernel26 apm ext2 ext3 usbhost usbgadget ppp"
KERNEL_DEVICETREE = "${S}/arch/arm/boot/dts/sama5d31ek.dts \
                     ${S}/arch/arm/boot/dts/sama5d33ek.dts \
                     ${S}/arch/arm/boot/dts/sama5d34ek.dts \
                     ${S}/arch/arm/boot/dts/sama5d35ek.dts"

PREFERRED_PROVIDER_virtual/kernel = "linux-yocto-custom"

VIRTUAL-RUNTIME_dev_manager = "busybox-mdev"
VIRTUAL-RUNTIME_login_manager ?= "busybox"
VIRTUAL-RUNTIME_init_manager ?= "busybox"


KERNEL_IMAGETYPE = "uImage"

DEFAULTTUNE = "cortexa9thf"

# used by sysvinit_2
SERIAL_CONSOLE ?= "115200 ttyS0"

ROOT_FLASH_SIZE = "256"
IMAGE_FSTYPES += "squashfs ubi tar.gz"

# NAND
MKUBIFS_ARGS = " -e 0x1f000 -c 2048 -m 0x800  -x lzo"
UBINIZE_ARGS = " -m 0x800 -p 0x20000 -s 2048"

UBI_VOLNAME = "rootfs"

UBOOT_ENTRYPOINT = "0x20008000"
UBOOT_LOADADDRESS = "0x20008000"
```

## conf/machine/xo1-mvs.conf
```bitbake
#@TYPE: Machine
#@Name: ATMEL SAMA5D3xek
#@DESCRIPTION: Machine configuration for Atmel's evaluation board

require conf/machine/include/tune-arm1136jf-s.inc

MACHINE_FEATURES = "kernel26 apm ext2 ext3 usbhost usbgadget ppp"
KERNEL_DEVICETREE = "${S}/arch/arm/boot/dts/sama5d31ek.dts"

#                     ${S}/arch/arm/boot/dts/sama5d33ek.dts 
#                     ${S}/arch/arm/boot/dts/sama5d34ek.dts 
#                     ${S}/arch/arm/boot/dts/sama5d35ek.dts"

PREFERRED_PROVIDER_virtual/kernel = "linux-yocto-custom"

VIRTUAL-RUNTIME_dev_manager = "busybox-mdev"
VIRTUAL-RUNTIME_login_manager ?= "busybox"
VIRTUAL-RUNTIME_init_manager ?= "busybox"


# Don't include kernels in standard images
RDEPENDS_kernel-base = ""

KERNEL_IMAGETYPE = "uImage"

  
  
DEFAULTTUNE = "armv6"

# used by sysvinit_2
SERIAL_CONSOLE ?= "38400 ttyS0"

ROOT_FLASH_SIZE = "256"
IMAGE_FSTYPES += "squashfs jffs2"


# NAND
MKUBIFS_ARGS = " -e 0x1f000 -c 2048 -m 0x800  -x lzo"
UBINIZE_ARGS = " -m 0x800 -p 0x20000 -s 2048"

JFFS2_ERASEBLOCK="128KiB"

UBI_VOLNAME = "rootfs"

UBOOT_ENTRYPOINT = "0x20008000"
UBOOT_LOADADDRESS = "0x20008000"
```

## recipes-xoware/xomkimage/files/sign_kernel_config_fit.its
```
/dts-v1/;

/ {
	description = "x.o.ware OS kernel image with FDT blobs";
	#address-cells = <1>;

	images {
		kernel@1 {
			data = /incbin/("zImage-initramfs-exokey.bin");
			type = "kernel";
			arch = "arm";
			os = "linux";
			compression = "none";
			load = <0x22000000>;
			entry = <0x22000000>;
			kernel-version = <1>;
			hash@1 {
				algo = "sha1";
			};
		};
		fdt@1 {
			description = "XO Device Tree";
			data = /incbin/("zImage-sama5d31ek.dtb");
			type = "flat_dt";
			arch = "arm";
			compression = "none";
			fdt-version = <1>;
			hash@1 {
				algo = "sha1";
			};
		};
	};
	configurations {
		default = "conf@1";
		conf@1 {
			description = "Boot Linux kernel with FDT blob";
			kernel = "kernel@1";
			fdt = "fdt@1";
			signature@1 {
				algo = "sha1,rsa2048";
				key-name-hint = "kernel_key";
			};
		};
	};
};
```
